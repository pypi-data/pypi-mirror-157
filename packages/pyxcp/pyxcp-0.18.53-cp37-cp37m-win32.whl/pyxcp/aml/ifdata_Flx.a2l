/begin XCP_ON_FLX 0x0100 /* XCP on FlexRay 1.0 */ 0x0019 /* T1_FLX [ms] */ "MyFlexRayNetwork.xml" /* FIBEX-file including CHI information */ "MyCluster" /* Cluster-ID */ 0x02 /* NAX */ HEADER_NAX_CTR_LEN PACKET_ALIGNMENT_8
 /begin INITIAL_CMD_BUFFER 0x01 MAX_FLX_LEN_BUF FIXED 32
  /begin LPDU_ID FLX_SLOT_ID FIXED 0x07B OFFSET FIXED 0 CYCLE_REPETITION FIXED 1 CHANNEL FIXED A /end LPDU_ID
  /begin XCP_PACKET CMD FIXED RES_ERR NOT_ALLOWED EV_SERV NOT_ALLOWED DAQ NOT_ALLOWED STIM FIXED /end XCP_PACKET
 /end INITIAL_CMD_BUFFER
 /begin INITIAL_RES_ERR_BUFFER 0x02 MAX_FLX_LEN_BUF FIXED 32
  /begin LPDU_ID FLX_SLOT_ID FIXED 0x07C OFFSET FIXED 1 CYCLE_REPETITION FIXED 1 CHANNEL FIXED A /end LPDU_ID
  /begin XCP_PACKET CMD NOT_ALLOWED RES_ERR FIXED EV_SERV FIXED DAQ FIXED STIM NOT_ALLOWED /end XCP_PACKET
 /end INITIAL_RES_ERR_BUFFER
 begin POOL_BUFFER 0x03 MAX_FLX_LEN_BUF FIXED 32
 /begin LPDU_ID FLX_SLOT_ID VARIABLE INITIAL_VALUE 0x07D OFFSET FIXED 0 CYCLE_REPETITION FIXED 1 CHANNEL FIXED A /end LPDU_ID
 /begin XCP_PACKET CMD NOT_ALLOWED RES_ERR VARIABLE EV_SERV VARIABLE DAQ VARIABLE_INITIALISED STIM NOT_ALLOWED /end XCP_PACKET
 /begin POOL_BUFFER 0x04 MAX_FLX_LEN_BUF VARIABLE 64
  /begin LPDU_ID FLX_SLOT_ID FIXED 0x07E OFFSET VARIABLE CYCLE_REPETITION VARIABLE CHANNEL FIXED A /end LPDU_ID
  /begin XCP_PACKET CMD VARIABLE RES_ERR VARIABLE EV_SERV VARIABLE DAQ VARIABLE STIM VARIABLE /end XCP_PACKET
 /end POOL_BUFFER
 /begin POOL_BUFFER 0x05 MAX_FLX_LEN_BUF VARIABLE 64
  /begin LPDU_ID FLX_SLOT_ID VARIABLE OFFSET VARIABLE CYCLE_REPETITION VARIABLE CHANNEL VARIABLE /end LPDU_ID
  /begin XCP_PACKET CMD VARIABLE RES_ERR VARIABLE EV_SERV VARIABLE DAQ VARIABLE STIM VARIABLE /end XCP_PACKET
 /end POOL_BUFFER
/end XCP_ON_FLX
